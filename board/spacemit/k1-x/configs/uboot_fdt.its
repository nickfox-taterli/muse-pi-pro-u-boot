## board/spacemit/k1-x/configs/uboot_fdt.its
```
/dts-v1/;

/ {
    description = "U-boot FIT image for k1x";
    #address-cells = <2>;
    fit,fdt-list = "of-list";

    images {
        uboot {
            description = "U-Boot";
            type = "firmware";
            os = "u-boot";
            arch = "riscv";
            compression = "none";
            load =  <0x0 0x00200000>;
            entry = <0x0 0x00200000>;
            data = /incbin/("../u-boot-nodtb.bin");
            hash-1 { algo = "crc32"; };
        };

        fdt {
            description = "k1-x_MUSE-Pi-Pro";
            type = "flat_dt";
            arch = "riscv";
            compression = "none";
            data = /incbin/("../dtb/k1-x_MUSE-Pi-Pro.dtb");
            hash-1 { algo = "crc32"; };
        };
    };

    configurations {
        default = "conf";
        conf {
            description = "k1-x_MUSE-Pi-Pro";
            firmware  = "uboot";
            fdt       = "fdt";
            hash-1 { algo = "crc32"; };
        };
    };
};
```
