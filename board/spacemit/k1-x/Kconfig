## board/spacemit/k1-x/Kconfig
```kconfig
if TARGET_SPACEMIT_K1X

config SYS_BOARD
	default "k1-x"

config SYS_VENDOR
	default "spacemit"

config SYS_CPU
	default "x60"

config SYS_CONFIG_NAME
	default "k1-x"

config SYS_TEXT_BASE
	default 0x81200000 if SPL
	default 0x80000000 if !RISCV_SMODE
	default 0x80200000 if RISCV_SMODE && ARCH_RV64I
	default 0x80400000 if RISCV_SMODE && ARCH_RV32I

config SPL_TEXT_BASE
	default 0x20100000

config SPL_OPENSBI_LOAD_ADDR
	hex
	default 0x21000000

config FDT_ADD_MEMORY_NODE
	bool "enable to add memory node to fdt before boot kernel"
	default n

config SPACEMIT_BUILD_BIN
	bool "build fsbl.bin for spacemit image"
	default n

config BOARD_SPECIFIC_OPTIONS # dummy
	def_bool y
	select SPACEMIT_X60
	select FDT_ADD_MEMORY_NODE
	imply AHCI
	imply SMP
	imply BOARD_LATE_INIT
	imply PCI_INIT_R
	imply SPL_RAM_SUPPORT
	imply SPL_RAM_DEVICE
	imply CMD_PCI
	imply CMD_POWEROFF
	imply CMD_SBI
	imply CMD_SCSI
	imply CMD_PING
	imply CMD_EXT2
	imply CMD_EXT4
	imply CMD_FAT
	imply CMD_FS_GENERIC
	imply DOS_PARTITION
	imply ISO_PARTITION
	imply EFI_PARTITION
	imply SCSI_AHCI
	imply AHCI_PCI
	imply E1000
	imply NVME
	imply PCI
	imply PCIE_ECAM_GENERIC
	imply SCSI
	imply DM_SCSI
	imply SYS_NS16550
	imply SIFIVE_SERIAL
	imply HTIF_CONSOLE if 64BIT
	imply SYSRESET
	imply SYSRESET_CMD_POWEROFF
	imply SYSRESET_SYSCON
	imply VIRTIO_MMIO
	imply VIRTIO_PCI
	imply VIRTIO_NET
	imply VIRTIO_BLK
	imply MTD_NOR_FLASH
	imply CFI_FLASH
	imply OF_HAS_PRIOR_STAGE

choice
	prompt "product board"
	default K1_X_BOARD_FPGA

config K1_X_BOARD_FPGA
	bool "k1-x board fpga"
	help
	  k1-x board is fpga.

config K1_X_BOARD_ASIC
	bool "k1-x board asic"
	help
	  k1-x board is asic.

config K1_X_BOARD_SIMULATION
	bool "k1-x board simulation"
	help
	  k1-x board is simulation.

endchoice

config SPL_BOOTING_NON_AI_CORE_SUPPORT
       bool "Support booting non ai core in SPL"
       depends on SPL_OPENSBI && K1_X_BOARD_ASIC
       help
         Support letting the non ai core as the booting cpu and bring it up
         first

config IMPORT_ENV_FROM_BOOTFS
	bool "Import environment variables from bootfs"
	default n
	help
	  Enable importing environment variables from bootfs partition.
	  This feature loads env.txt from bootfs and imports it to U-Boot
	  environment variables. If disabled, the import_env_from_bootfs()
	  function will not be called during boot.

config SKIP_CARD_FIRMWARE_FLASH
	bool "Skip SD card firmware auto-flash"
	default n
	help
	  Skip automatic firmware flash from SD card during boot.
	  When enabled, the system will not scan SD card for 
	  partition_universal.json and will not execute flash_image mmc
	  command automatically. The actual flash functionality in 
	  flash_image command remains available for manual execution.

config K1X_SET_ETHADDR
	bool "Set Ethernet MAC address"
	default y
	help
	  Enable setting Ethernet MAC address from TLV EEPROM or generate
	  random MAC address if not found. This function reads MAC addresses
	  from EEPROM and sets ethaddr/eth1addr environment variables.

config K1X_SET_SERIAL_NO
	bool "Set device serial number"
	default y
	help
	  Enable setting device serial number from TLV EEPROM.
	  This function reads serial number and sets serial# environment variable.

config K1X_REFRESH_CONFIG
	bool "Refresh configuration information"
	default y
	help
	  Enable refreshing configuration information from TLV EEPROM.
	  This function reads various config items like serial number and
	  updates corresponding environment variables.

config K1X_SET_DATA_BUFFER
	bool "Set data buffer environment variables"
	default y
	help
	  Enable setting data buffer environment variables based on DDR capacity.
	  This function configures fastboot_buffer_size, decompress_addr,
	  ramdisk_addr and dtb_addr according to available memory.

config K1X_SET_PRODUCT_NAME
	bool "Set default product name"
	default y
	help
	  Enable setting default product name when product_name environment
	  variable is not set. This function sets product_name to DEFAULT_PRODUCT_NAME
	  when no product name is available from environment or EEPROM.

config K1X_NV_REBOOT_TRIGGERS
    bool "Allow boot-mode override via non-reset registers"
    default n
    help
      Read/consume BOOT_CIU_DEBUG_REG0 and PMIC P1_NON_RESET_REG to override
      boot mode (e.g. jump into fastboot). Disable to ignore software-set flags.

config K1X_EARLY_SHELL_SUPPORT
    bool "Support early U-Boot shell entry"
    default y
    help
      Enable early entry into U-Boot shell based on boot mode or
      non-reset register settings. When enabled, the system can
      enter shell mode early in the boot process if BOOT_MODE_SHELL
      is detected. Disable to prevent early shell entry and force
      normal boot sequence.

endif
```
